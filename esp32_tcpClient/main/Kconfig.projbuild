## esp32_tcpClient/main/Kconfig.projbuild
```kconfig
menu "LED Matrix Configuration"

    config ESP_USE_SPI
        bool "Use SPI backend for the led strip"
        default "y"
        help
            Use SPI backend for the led strip
    
    config ESP_USE_RMT
        bool "Use RMT backend for the led strip"
        default "n"
        help
            Use RMT backend for the led strip
    
    config ESP_LED_STRIP_GPIO
        int "GPIO pin for data"
        default 13
        help
            GPIO pin to use for transferring data to the led strip
    
    config ESP_LED_STRIP_LED_NUMBER
        int "Number of LEDs"
        default 10
        help
            Number of LEDs to support on the led strip
    
    config ESP_LED_STRIP_RMT_RES_HZ
        int "Resolution of RMT"
        default 10000000
        help
            10MHz resolution, 1 tick = 0.1us (led strip needs a high resolution)

    config ESP_WIFI_SSID
        string "WiFi SSID"
        default "myssid"
        help
            SSID (network name) for the ESP to connect to.

    config ESP_WIFI_PASSWORD
        string "WiFi Password"
        default "mypassword"
        help
            WiFi password (WPA or WPA2) for the ESP to use.

    config ESP_MAXIMUM_RETRY
        int "Maximum retry"
        default 5
        help
            Set the Maximum retry to avoid station reconnecting to the AP unlimited when the AP is really inexistent.
    
    choice WIFI_IP_MODE
        prompt "IP Version"
        help
            ESP can use either IPV4 or IPV6 (not really).

        config WIFI_IPV4
            bool "IPV4"

        config WFIF_IPV6
            bool "IPV6"

    endchoice

    config WIFI_IPV4_ADDR
        string "IPV4 Address"
        default "192.168.1.217"
        help
            The ESP will connect to this IPV4 address.

    config WIFI_IPV4_PORT
        int "Port"
        range 0 65535
        default 3333
        help
            The remote port to which the client will connect to.

    choice EXAMPLE_INTERFACE
        prompt "Interface selection"
        help
            Example can use either "Auto" or "User specified".

        config IFACE_AUTO
            bool "Auto"

        config USER_SPECIFIED_IFACE
            bool "User specified interface"
    endchoice

    config USER_SPECIFIED_IFACE_NAME
        string "User specified interface name"
        default "st1"
        depends on USER_SPECIFIED_IFACE
        help
            This interface will be used for communication.

    choice SOCKET_IP_INPUT
        prompt "Socket example source"
        default SOCKET_IP_INPUT_STRING
        help
            Selects the input source of the IP used in the example.

        config SOCKET_IP_INPUT_STRING
            bool "From string"

        config SOCKET_IP_INPUT_STDIN
            bool "From stdin"
    endchoice

    config IPV4
        bool "IPV4"
        default y
        depends on LWIP_IPV4

    config IPV6
        bool "IPV6"
        default n
        select CONNECT_IPV6

    config TCP_KEEPALIVE_IDLE
        int "TCP keep-alive idle time(s)"
        default 5
        help
            Keep-alive idle time. In idle time without receiving any data from peer, will send keep-alive probe packet

    config TCP_KEEPALIVE_INTERVAL
        int "TCP keep-alive interval time(s)"
        default 5
        help
            Keep-alive probe packet interval time.

    config TCP_KEEPALIVE_COUNT
        int "TCP keep-alive packet retry send counts"
        default 3
        help
            Keep-alive probe packet retry count.

endmenu
```
